## UsbSmokeIdf/sdkconfig.defaults
```kconfig
# Default target for this firmware. Required so a clean clone does not fall
# back to esp32, which is incompatible with the TinyUSB device stack used here.
CONFIG_IDF_TARGET="esp32s3"

# Versioned partition table. The FILE_* protocol stores program TXT files in
# the LittleFS partition labelled "storage", mounted at /fs.
CONFIG_PARTITION_TABLE_CUSTOM=y
CONFIG_PARTITION_TABLE_CUSTOM_FILENAME="partitions.csv"
CONFIG_PARTITION_TABLE_FILENAME="partitions.csv"
CONFIG_PARTITION_TABLE_OFFSET=0x8000
CONFIG_PARTITION_TABLE_MD5=y

# The Acuratex USB bridge exposes a vendor-specific WinUSB interface.
CONFIG_TINYUSB_VENDOR_COUNT=1
CONFIG_TINYUSB_VENDOR_RX_BUFSIZE=64
CONFIG_TINYUSB_VENDOR_TX_BUFSIZE=64
CONFIG_TINYUSB_VENDOR_EPSIZE=64

# Keep the vendor interface exclusive on the USB OTG controller.
# USB Serial/JTAG can steal the physical USB path and hide the WinUSB bridge.
# CONFIG_USJ_ENABLE_USB_SERIAL_JTAG is not set
# CONFIG_ESP_CONSOLE_SECONDARY_USB_SERIAL_JTAG is not set
# CONFIG_ESP_CONSOLE_USB_SERIAL_JTAG_ENABLED is not set
CONFIG_ESP_CONSOLE_SECONDARY_NONE=y
```
