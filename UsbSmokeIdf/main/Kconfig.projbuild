## UsbSmokeIdf/main/Kconfig.projbuild
```kconfig
menu "Acuratex firmware options"

    config ACURATEX_USB_DEBUG_JTAG
        bool "Use integrated USB Serial/JTAG instead of Acuratex TinyUSB"
        default n
        help
            Leave GPIO19/GPIO20 available to the ESP32-S3 integrated USB
            Serial/JTAG controller. The Acuratex TinyUSB driver is not
            initialized, while WiFi/TCP, CAN/TWAI and command processing keep
            their normal startup path.

endmenu
```

## UsbSmokeIdf/sdkconfig.defaults.debug-jtag
```kconfig
# Debug uses the ESP32-S3 integrated USB Serial/JTAG controller on GPIO19/GPIO20.
CONFIG_IDF_TARGET="esp32s3"
CONFIG_ESPTOOLPY_FLASHSIZE_16MB=y
CONFIG_ESPTOOLPY_FLASHSIZE="16MB"
CONFIG_PARTITION_TABLE_CUSTOM=y
CONFIG_PARTITION_TABLE_CUSTOM_FILENAME="partitions.csv"
CONFIG_PARTITION_TABLE_FILENAME="partitions.csv"
CONFIG_PARTITION_TABLE_OFFSET=0x8000
CONFIG_PARTITION_TABLE_MD5=y
CONFIG_TINYUSB_VENDOR_COUNT=1
CONFIG_TINYUSB_VENDOR_RX_BUFSIZE=64
CONFIG_TINYUSB_VENDOR_TX_BUFSIZE=64
CONFIG_TINYUSB_VENDOR_EPSIZE=64
CONFIG_ACURATEX_USB_DEBUG_JTAG=y
CONFIG_USJ_ENABLE_USB_SERIAL_JTAG=y
# CONFIG_ESP_CONSOLE_SECONDARY_USB_SERIAL_JTAG is not set
# CONFIG_ESP_CONSOLE_USB_SERIAL_JTAG is not set
CONFIG_ESP_CONSOLE_SECONDARY_NONE=y
```
